## Kconfig
```kconfig
# Copyright 2026 Roman Kuzmitskii (@damex)
# SPDX-License-Identifier: MIT

menuconfig SENSOR_STEPPED_ENCODER
    bool "Stepped quadrature rotary encoder"
    default y
    depends on DT_HAS_ZMK_STEPPED_ENCODER_ENABLED
    depends on GPIO
    depends on SENSOR
    help
      Detented quadrature encoder driver. Edge interrupt wakes fixed-rate
      polling, so contact chatter cannot storm the ISR or flood a split link.

if SENSOR_STEPPED_ENCODER

module = SENSOR_STEPPED_ENCODER
module-str = stepped encoder
source "subsys/logging/Kconfig.template.log_config"

endif # SENSOR_STEPPED_ENCODER
```

## dts/bindings/sensor/zmk,stepped-encoder.yaml
```yaml
# Copyright 2026 Roman Kuzmitskii (@damex)
# SPDX-License-Identifier: MIT

description: Detented quadrature rotary encoder

compatible: "zmk,stepped-encoder"

properties:
  a-gpios:
    type: phandle-array
    required: true
    description: Channel A pin.
  b-gpios:
    type: phandle-array
    required: true
    description: Channel B pin.
  steps:
    type: int
    required: true
    description: Quadrature pulses per full rotation.
```

## tests/native_sim/report/testcase.yaml
```yaml
# Copyright 2026 Roman Kuzmitskii (@damex)
# SPDX-License-Identifier: MIT
---
common:
  tags:
    - stepped_encoder

tests:
  stepped_encoder.report:
    platform_allow:
      - native_sim/native/64
    integration_platforms:
      - native_sim/native/64
```

## tests/native_sim/rotation/testcase.yaml
```yaml
# Copyright 2026 Roman Kuzmitskii (@damex)
# SPDX-License-Identifier: MIT
---
common:
  tags:
    - stepped_encoder

tests:
  stepped_encoder.rotation:
    platform_allow:
      - native_sim/native/64
    integration_platforms:
      - native_sim/native/64
```

## tests/native_sim/trigger/testcase.yaml
```yaml
# Copyright 2026 Roman Kuzmitskii (@damex)
# SPDX-License-Identifier: MIT
---
common:
  tags:
    - stepped_encoder

tests:
  stepped_encoder.trigger:
    platform_allow:
      - native_sim/native/64
    integration_platforms:
      - native_sim/native/64
```

## tests/unit/testcase.yaml
```yaml
# Copyright 2026 Roman Kuzmitskii (@damex)
# SPDX-License-Identifier: MIT

common:
  tags:
    - stepped_encoder

tests:
  stepped_encoder.unit:
    type: unit
```
